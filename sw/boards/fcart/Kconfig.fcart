## sw/boards/fcart/Kconfig.fcart
```kconfig
config BOARD_FCART
	select SOC_STM32F412RX
	select USE_STM32_HAL_QSPI
	select USE_STM32_HAL_DMA
```

## sw/boards/fcart/fcart_defconfig
```kconfig
# Enable MPU
CONFIG_ARM_MPU=y

# Enable HW stack protection
CONFIG_HW_STACK_PROTECTION=y

# enable GPIO
CONFIG_GPIO=y

# clock configuration
CONFIG_CLOCK_CONTROL=y

# enable pin controller
CONFIG_PINCTRL=y
```
